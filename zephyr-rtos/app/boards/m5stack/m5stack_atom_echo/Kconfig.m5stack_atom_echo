## zephyr-rtos/app/boards/m5stack/m5stack_atom_echo/Kconfig.m5stack_atom_echo
```kconfig
# M5Stack Atom Lite board configuration

# Copyright (c) 2024 Nikola Trifunovic <nikola@trifunovic.at>
# Copyright (c) 2022 AVSystem Sławomir Wolf Sp.j. (AVSystem)
# SPDX-License-Identifier: Apache-2.0

config BOARD_M5STACK_ATOM_ECHO
	select SOC_ESP32_PICO_D4
	select SOC_ESP32_PROCPU if BOARD_M5STACK_ATOM_ECHO_ESP32_PROCPU
	select SOC_ESP32_APPCPU if BOARD_M5STACK_ATOM_ECHO_ESP32_APPCPU
```

## zephyr-rtos/app/west.yml
```yaml
manifest:
  projects:
    - name: zephyr
      url: https://github.com/zephyrproject-rtos/zephyr
      revision: main
      import:
        name-allowlist:
          - hal_espressif
          - hal_xtensa
          - tinycrypt
```
